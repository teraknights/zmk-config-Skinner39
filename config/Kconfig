## config/Kconfig
```kconfig
config ZMK_SENSOR_TRACKBALL
    bool "Enable Trackball Sensor Behavior"
    default y
    help
        Enables trackball sensor behavior for dynamic layer switching.
```

## config/boards/arm/skinner39/skinner39_right_defconfig
```kconfig
# SPDX-License-Identifier: MIT



CONFIG_INPUT=y
CONFIG_ZMK_MOUSE=y
CONFIG_PMW3610=y
CONFIG_PMW3610_INVERT_X=n
CONFIG_PMW3610_INVERT_Y=y
CONFIG_PMW3610_SMART_ALGORITHM=y

## tera add
## test
CONFIG_ZMK_SPLIT_ROLE_CENTRAL=y
## test
CONFIG_PMW3610_CPI=400
CONFIG_PMW3610_CPI_DIVIDOR=1
CONFIG_PMW3610_ORIENTATION_180=y
# CONFIG_PMW3610_SNIPE_CPI=800
# CONFIG_PMW3610_SNIPE_CPI_DIVIDOR=4
CONFIG_PMW3610_SCROLL_TICK=16
CONFIG_PMW3610_INVERT_X=n
CONFIG_PMW3610_INVERT_SCROLL_X=y
CONFIG_PMW3610_RUN_DOWNSHIFT_TIME_MS=3264
CONFIG_PMW3610_REST1_SAMPLE_TIME_MS=20
#CONFIG_PMW3610_REST1_DOWNSHIFT_TIME_MS=9600
#CONFIG_PMW3610_REST2_SAMPLE_TIME_MS=
#CONFIG_PMW3610_REST2_DOWNSHIFT_TIME_MS=
#CONFIG_PMW3610_REST3_SAMPLE_TIME_MS=
#CONFIG_PMW3610_REST3_DOWNSHIFT_TIME_MS=
#CONFIG_PMW3610_FORCE_AWAKE=n
CONFIG_PMW3610_POLLING_RATE_125_SW=y
CONFIG_PMW3610_AUTOMOUSE_TIMEOUT_MS=700
CONFIG_PMW3610_SMART_ALGORITHM=y
CONFIG_PMW3610_ADJUSTABLE_MOUSESPEED=y
CONFIG_PMW3610_MOVEMENT_THRESHOLD=5
##tera end


CONFIG_ZMK_EXT_POWER=y
CONFIG_SOC_SERIES_NRF52X=y
CONFIG_SOC_NRF52840_QIAA=y
CONFIG_BOARD_SKINNER39_RIGHT=y
# tera add
CONFIG_ZMK_STUDIO=y
CONFIG_ZMK_STUDIO_LOCKING=n
# tera end

CONFIG_LOG_PROCESS_THREAD_STARTUP_DELAY_MS=4000
CONFIG_ZMK_DISPLAY=y
CONFIG_SPI=y
# Enable MPU
CONFIG_ARM_MPU=y

CONFIG_PINCTRL=y

CONFIG_GPIO=y

CONFIG_USE_DT_CODE_PARTITION=y
CONFIG_BUILD_OUTPUT_UF2=y

CONFIG_MPU_ALLOW_FLASH_WRITE=y
CONFIG_NVS=y
CONFIG_SETTINGS_NVS=y
CONFIG_FLASH=y
CONFIG_FLASH_PAGE_LAYOUT=y
CONFIG_FLASH_MAP=y

CONFIG_ZMK_USB=y
CONFIG_ZMK_BLE=y
```

## config/modules/custom_mouse/Kconfig
```kconfig
config ZMK_CUSTOM_MOUSE
    bool "Enable custom mouse module"
    default y
    help
      Enable the custom mouse module for automatic mouse layer switching.
```

## config/west.yml
```yaml
manifest:
  remotes:
    - name: zmk
      url-base: https://github.com/zmkfirmware
    - name: badjeff
      url-base: https://github.com/badjeff
    - name: yangxing
      url-base: https://github.com/yangxing844
  projects:
    - name: zmk
      remote: zmk
      revision: main
      import: app/west.yml
    - name: zmk-pmw3610-driver
      remote: badjeff
      revision: main
    - name: zmk-split-peripheral-input-relay
      remote: badjeff
      revision: main
    - name: zmk-input-behavior-listener
      remote: badjeff
      revision: main
    - name: zmk-lpm009m360a-driver
      remote: yangxing
      revision: master
    - name: custom_mouse
      path: config/modules/custom_mouse
      revision: main
  self:
    path: config
    west-commands: config/west-commands.yml  # カスタムモジュールのコマンドを定義
  projects:
    - name: zmk
      url: https://github.com/zmkfirmware/zmk.git
      revision: main
      import: app
```
